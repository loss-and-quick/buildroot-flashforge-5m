## package/python-aiolimiter/Config.in
```kconfig
config BR2_PACKAGE_PYTHON_AIOLIMITER
	bool "python-aiolimiter"
	help
	  asyncio rate limiter, a leaky bucket implementation.

	  https://github.com/mjpieters/aiolimiter
```

## package/python-apscheduler/Config.in
```kconfig
config BR2_PACKAGE_PYTHON_APSCHEDULER
	bool "python-apscheduler"
	select BR2_PACKAGE_PYTHON_TZLOCAL
	select BR2_PACKAGE_PYTHON_TENACITY
	select BR2_PACKAGE_PYTHON_ATTRS
	select BR2_PACKAGE_PYTHON_ANYIO
	help
		Task scheduling library for Python

		https://pypi.org/pypi/APScheduler
```

## package/python-emoji/Config.in
```kconfig
config BR2_PACKAGE_PYTHON_EMOJI
	bool "python-emoji"
	help
		emoji terminal output for Python

		https://pypi.org/project/emoji/
```

## package/python-exceptiongroup/Config.in
```kconfig
config BR2_PACKAGE_PYTHON_EXCEPTIONGROUP
	bool "python-exceptiongroup"
	select BR2_PACKAGE_PYTHON_TYPING_EXTENSIONS # runtime
	help
		Backport of PEP 654 (exception groups)

		https://pypi.org/project/exceptiongroup
```

## package/python-ffmpegcv/Config.in
```kconfig
config BR2_PACKAGE_PYTHON_FFMPEGCV
	bool "python-ffmpegcv"
	select BR2_PACKAGE_FFMPEG
	select BR2_PACKAGE_PYTHON_NUMPY
	help
	  The ffmpegcv is a ffmpeg backbone for open-cv like Video Reader and Writer

	  https://pypi.org/pypi/ffmpegcv
```

## package/python-flit-scm/Config.in
```kconfig
config BR2_PACKAGE_PYTHON_FLIT_SCM
	bool "python-flit-scm"
	select BR2_PACKAGE_PYTHON_FLIT_CORE
	select BR2_PACKAGE_PYTHON_SETUPTOOLS_SCM
	select BR2_PACKAGE_PYTHON_TOMLI
	help
		A PEP 518 build backend that uses setuptools_scm to generate a version file from your version control system, then flit to build the package.
```

## package/python-socksio/Config.in
```kconfig
config BR2_PACKAGE_PYTHON_SOCKSIO
	bool "python-socksio"
	help
	  Sans-I/O implementation of SOCKS4, SOCKS4A, and SOCKS5.

	  https://github.com/sethmlarson/socksio
```

## package/python-telegram-bot/Config.in
```kconfig
config BR2_PACKAGE_PYTHON_TELEGRAM_BOT
	bool "python-telegram-bot"
	select BR2_PACKAGE_PYTHON_HTTPX # runtime
	help
	  We have made you a wrapper you can't refuse.

	  https://python-telegram-bot.org
```

## package/python-tenacity/Config.in
```kconfig
config BR2_PACKAGE_PYTHON_TENACITY
	bool "python-tenacity"
	help
	  Retry code until it succeeds.

	  https://github.com/jd/tenacity
```
